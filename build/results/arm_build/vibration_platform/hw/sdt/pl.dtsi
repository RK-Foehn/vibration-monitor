/ {
	amba_pl: amba_pl {
		ranges;
		compatible = "simple-bus";
		#address-cells = <1>;
		#size-cells = <1>;
		lis3dh_vibration_axi_0: lis3dh_vibration_axi_wrapper@40000000 {
			xlnx,rable = <0>;
			compatible = "xlnx,lis3dh-vibration-axi-wrapper-1.0";
			status = "okay";
			clock-names = "s_axi_aclk";
			xlnx,ip-name = "lis3dh_vibration_axi_wrapper";
			xlnx,edk-iptype = "PERIPHERAL";
			reg = <0x40000000 0x1000>;
			clocks = <&clkc 15>;
			xlnx,name = "lis3dh_vibration_axi_0";
		};
	};
};
